## main/Kconfig.projbuild
```kconfig
menu "Mycodo Remote Node Configuration"

    config APP_WIFI_SSID
        string "Wi-Fi SSID"
        default "CHANGE_ME_WIFI_SSID"
        help
            Safe default Wi-Fi SSID placeholder. Change this locally with
            'idf.py menuconfig' so your real SSID stays in the ignored
            sdkconfig file instead of Git-tracked source files.

    config APP_WIFI_PASSWORD
        string "Wi-Fi password"
        default "CHANGE_ME_WIFI_PASSWORD"
        help
            Safe default Wi-Fi password placeholder. Change this locally with
            'idf.py menuconfig' so your real password stays in the ignored
            sdkconfig file instead of Git-tracked source files.

    config APP_WIFI_MAXIMUM_RETRY_COUNT
        int "Wi-Fi maximum retry count"
        range 0 20
        default 5
        help
            Maximum reconnect attempts before the Wi-Fi manager reports a safe
            failure state instead of retrying forever.

    config APP_MQTT_BROKER_HOST
        string "MQTT broker host or IP"
        default "CHANGE_ME_MQTT_HOST"
        help
            Safe default MQTT broker placeholder. Change this locally with
            'idf.py menuconfig' so your real broker host or IP stays in the
            ignored sdkconfig file instead of Git-tracked source files.

    config APP_MQTT_BROKER_PORT
        int "MQTT broker port"
        range 1 65535
        default 1883
        help
            TCP port used by the MQTT broker. The default Mosquitto port is
            1883 for non-TLS local network testing.

    config APP_MQTT_USERNAME
        string "MQTT username (optional)"
        default ""
        help
            Optional MQTT username. Change this locally with
            'idf.py menuconfig' so any real broker credentials stay in the
            ignored sdkconfig file.

    config APP_MQTT_PASSWORD
        string "MQTT password (optional)"
        default ""
        help
            Optional MQTT password. Change this locally with
            'idf.py menuconfig' so any real broker credentials stay in the
            ignored sdkconfig file.

    config APP_MQTT_BASE_TOPIC_ROOT
        string "MQTT base topic root"
        default "mycodo/remote"
        help
            Root topic prefix. The firmware appends the node ID at runtime,
            producing topics like 'mycodo/remote/remote-node-01/status'.

    config APP_MQTT_HEARTBEAT_INTERVAL_SECONDS
        int "MQTT heartbeat interval (seconds)"
        range 5 3600
        default 30
        help
            Interval between heartbeat and stub telemetry publishes once MQTT
            is connected.

endmenu
```
